## sdkconfig.defaults
```kconfig
# --- 目标芯片 ---
CONFIG_IDF_TARGET="esp32c3"
# 注:ESP32-C3 无 PSRAM,故不设 CONFIG_SPIRAM。

# --- Flash ---
# FoloToy AI Passport 的所有硬件批次均使用 8MB Flash。
CONFIG_ESPTOOLPY_FLASHSIZE_8MB=y
# 烧录时按实际探测容量回写镜像头。
CONFIG_ESPTOOLPY_HEADER_FLASHSIZE_UPDATE=y

# --- 控制台:USB-Serial-JTAG(C3 原生 USB,GPIO18/19)---
# 不用 UART0:其默认 TX=GPIO21 与本板背光引脚冲突。
CONFIG_ESP_CONSOLE_USB_SERIAL_JTAG=y
CONFIG_ESP_CONSOLE_SECONDARY_NONE=y

# --- LVGL ---
CONFIG_LV_COLOR_DEPTH_16=y
CONFIG_LV_FONT_MONTSERRAT_14=y
CONFIG_LV_FONT_MONTSERRAT_20=y
# 只使用本项目界面,不编 LVGL 自带示例。
# CONFIG_LV_BUILD_EXAMPLES is not set
# LVGL 内置池为 48 KiB。中文界面实机峰值低于 20 KiB；
# 相比 64 KiB 再释放 16 KiB，覆盖 TCP 接收窗口扩大的动态内存预算。
# 保留 UI 余量；新增界面/素材后须重新测量峰值，不能仅以链接余量判断安全。
CONFIG_LV_MEM_SIZE=49152
CONFIG_LV_MEM_SIZE_KILOBYTES=0

# --- 分区表 ---
# 歌曲放在独立 FAT 分区，启动音由固件内嵌。
CONFIG_PARTITION_TABLE_CUSTOM=y
CONFIG_PARTITION_TABLE_CUSTOM_FILENAME="partitions.csv"

# 上传模式开启无密码 SoftAP；保留受限 Wi-Fi 缓冲，为直播配置 TCP 窗口。
CONFIG_ESP_WIFI_SOFTAP_SUPPORT=y
CONFIG_ESP_WIFI_ENABLED=y
CONFIG_ESP_WIFI_STATIC_RX_BUFFER_NUM=3
CONFIG_ESP_WIFI_DYNAMIC_RX_BUFFER_NUM=6
CONFIG_ESP_WIFI_RX_BA_WIN=3
CONFIG_LWIP_TCPIP_RECVMBOX_SIZE=16
CONFIG_LWIP_TCP_SND_BUF_DEFAULT=2880
# 从旧上传模式的 2 MSS 扩至 8 MSS，须以设备收流数据验收。
CONFIG_LWIP_TCP_WND_DEFAULT=11520
# IDF 推荐接收队列至少为窗口/MSS+2，避免队列满时丢包。
CONFIG_LWIP_TCP_RECVMBOX_SIZE=10
CONFIG_ESP_WIFI_ENABLE_WPA3_SAE=n
CONFIG_ESP_WIFI_ESPNOW_MAX_ENCRYPT_NUM=0
CONFIG_ESP_WIFI_DYNAMIC_RX_MGMT_BUFFER=y
CONFIG_ESP_WIFI_IRAM_OPT=n
CONFIG_ESP_WIFI_RX_IRAM_OPT=n
CONFIG_ESP_WIFI_ENTERPRISE_SUPPORT=n

# --- 系统 ---
CONFIG_FREERTOS_HZ=1000

# 断流现场出现乱序段等待缺失数据，启用选择确认以支持多段丢包恢复。
CONFIG_LWIP_TCP_SACK_OUT=y
```
